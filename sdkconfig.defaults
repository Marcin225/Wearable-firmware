## sdkconfig.defaults
```kconfig
CONFIG_AUTOSTART_ARDUINO=y
CONFIG_FREERTOS_HZ=1000

CONFIG_PM_ENABLE=y
CONFIG_FREERTOS_USE_TICKLESS_IDLE=y
CONFIG_FREERTOS_IDLE_TIME_BEFORE_SLEEP=3

CONFIG_BT_ENABLED=y
CONFIG_BT_NIMBLE_ENABLED=n

CONFIG_BT_CTRL_MODEM_SLEEP=y
CONFIG_BT_CTRL_MODEM_SLEEP_MODE_1=y
CONFIG_BT_CTRL_LPCLK_SEL_MAIN_XTAL=y
CONFIG_BT_CTRL_MAIN_XTAL_PU_DURING_LIGHT_SLEEP=y

CONFIG_ESP_PHY_MAC_BB_PD=y

CONFIG_ESPTOOLPY_FLASHSIZE_4MB=y

CONFIG_COMPILER_DISABLE_GCC8_WARNINGS=y
```
